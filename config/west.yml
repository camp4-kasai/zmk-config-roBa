## config/west.yml
```yaml
manifest:
  remotes:
    - name: zmkfirmware
      url-base: https://github.com/zmkfirmware
    - name: kumamuk-git
      url-base: https://github.com/kumamuk-git
    - name: caksoylar  # <-- new entry
      url-base: https://github.com/caksoylar
    - name: camp4-kasai
      url-base: https://github.com/camp4-kasai
  projects:
    - name: zmk
      remote: zmkfirmware
      revision: main
      import: app/west.yml
    #- name: zmk-pmw3610-driver
    #  remote: kumamuk-git
    - name: zmk-pmw3610-driver-roba
      remote: camp4-kasai
      revision: main
    - name: zmk-rgbled-widget  # <-- new entry
      remote: caksoylar
      revision: main
  self:
    path: config
```
